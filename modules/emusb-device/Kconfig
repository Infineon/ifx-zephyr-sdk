## modules/emusb-device/Kconfig
```kconfig
# SPDX-FileCopyrightText: Copyright (c) 2026 Infineon Technologies AG,
# SPDX-FileCopyrightText: or an affiliate of Infineon Technologies AG. All rights reserved.
#
# SPDX-License-Identifier: Apache-2.0
#
# SEGGER emUSB-Device integration for Zephyr

# Hidden symbol set automatically when this module is present, so that other
# Kconfig/CMake logic can detect emUSB-Device availability.
config ZEPHYR_EMUSB_DEVICE_MODULE
	bool

menuconfig EMUSB_DEVICE
	bool "SEGGER emUSB-Device USB stack"
	depends on DT_HAS_INFINEON_USBHS_ENABLED && SOC_SERIES_PSE84 && !UDC_DRIVER
	help
	  Link the SEGGER emUSB-Device stack (shipped by Infineon as a
	  pre-compiled library plus headers) into the application. The
	  application must provide the emUSB configuration sources
	  (usbd_config.c / usbd_config_io.c, templates live under
	  vendor modules/hal/infineon/emusb-device/export/Config directory)
          and call USBD_Init() / USBD_Start().

if EMUSB_DEVICE

config EMUSB_DEVICE_CONFIG_PATH
	string "Directory containing the application emUSB config headers"
	default ""
	help
	  Absolute path of the directory that holds the application-provided
	  emUSB configuration headers (e.g. USB_Conf.h). Added to the global
	  include path so the emUSB headers can find them. Leave empty if the
	  application already exposes them via zephyr_include_directories().

config EMUSB_DEVICE_RTOS_AWARE
	bool "Build the RTOS-aware OS abstraction layer"
	default y
	select USE_INFINEON_ABSTRACTION_RTOS
	help
	  Compile the emUSB OS abstraction (usbd_os_abs_rtos.c) with
	  COMPONENT_RTOS_AWARE, routing emUSB OS primitives onto the Zephyr
	  kernel through the Infineon abstraction-rtos layer. Disable only for
	  a bare (no-RTOS) super-loop integration.

config EMUSB_DEVICE_DMA
	bool "Use the DMA USB device driver"
	help
	  Build the DMA-based emUSB glue (ifx_emusb_dma_configure): cache
	  maintenance hooks (SCB clean/invalidate on Cortex-M55, no-ops on the
	  cacheless Cortex-M33) and a DMA-address validator. The application
	  must select USB_Driver_Infineon_PSOCE84_DMA and place all transfer
	  buffers (the assigned memory pool and any USBD_BULK_Write/Read
	  buffers) in DMA-reachable SRAM (and, on M55, in non-cacheable memory).
	  Offloads the FIFO copy from the CPU for much higher bulk throughput.

config EMUSB_DEVICE_USE_PDL
	bool "Build the emUSB config/OS sources with USBD_USE_PDL=1"
	default n
	help
	  Compile the application/OS emUSB sources with USBD_USE_PDL=1. The
	  ModusToolbox reference (COMPONENTS=USBD_BASE) leaves this at 0, so it
	  defaults to n here. Enabling it requires the application to disable
	  the emUSB standard debug output (USBD_DISABLE_STANDARD_OUTPUT=1).

config EMUSB_DEVICE_DEBUG_BUILD
	bool "Link the Debug build of the emUSB library"
	default n
	help
	  Link the CONFIG_Debug pre-compiled emUSB library variant (extra
	  logging / asserts) instead of CONFIG_Release. Only affects which
	  pre-built archive is selected.

choice EMUSB_DEVICE_EMFILE
	prompt "emFile (MSD) library variant"
	default EMUSB_DEVICE_EMFILE_NONE
	help
	  Select whether to link the plain emUSB-Device base library or one of
	  the emFile-enabled variants used by the Mass Storage Device class
	  with a FAT file system.

config EMUSB_DEVICE_EMFILE_NONE
	bool "None (base library)"

config EMUSB_DEVICE_EMFILE_FAT16
	bool "emFile FAT16"

config EMUSB_DEVICE_EMFILE_FAT32
	bool "emFile FAT32"

endchoice

endif # EMUSB_DEVICE
```

## samples/audio-front-end/zephyr/Kconfig
```kconfig
config AUDIOFE
	bool "Infineon Audio Front-End (AFE) Library"
	help
	  Enable the Infineon Audio Front-End middleware library.

if AUDIOFE

config AUDIOFE_SPEECH_ENH
	bool "Enable Speech Enhancement Support"
	default n
	help
	  Enable speech enhancement paths that depend on Audio Voice Core.
	  Default is disabled for basic mode integration.

config AUDIOFE_LOGGING
	bool "Enable AFE Logging Support"
	default n
	help
	  Enable additional AFE logging support.

config AUDIOFE_TUNING
	bool "Enable AFE Tuning Feature"
	default n
	help
	  Enable AFE tuning interfaces for runtime parameter updates.

config AUDIOFE_DEBUG
	bool "Enable AFE Debug Features"
	default n
	help
	  Enable debug features and extra diagnostics.

choice AUDIOFE_BUILD_MODE
	prompt "AFE Build Mode"
	default AUDIOFE_BASIC_ONLY

config AUDIOFE_BASIC_ONLY
	bool "Basic AFE only"
	help
	  Build basic AFE functionality with compatibility stubs.

config AUDIOFE_FULL_BUILD
	bool "Full AFE build"
	depends on AUDIOFE_SPEECH_ENH
	help
	  Build full AFE functionality including speech enhancement.

endchoice

endif # AUDIOFE
```

## west.yml
```yaml
# Copyright (c) 2026 Infineon Technologies AG,
# or an affiliate of Infineon Technologies AG.
#
# SPDX-License-Identifier: Apache-2.0

manifest:
  self:
    west-commands: scripts/west-commands.yml

  remotes:
    - name: infineon-github
      url-base: https://github.com/Infineon

    - name: lvgl
      url-base: https://github.com/lvgl

  projects:
    - name: ifx-zephyr
      remote: infineon-github
      repo-path: ifx-zephyr
      revision: 5a9db6198d786edc3ef88c47bb41cb7cb33e9909
      import:
        # By using name-allowlist we can clone only the modules that are
        # strictly needed by the application.
        name-allowlist:
          - cmsis_6
          - hal_infineon
          - mbedtls
          - mbedtls-3.6
          - mcuboot
          - tf-psa-crypto
          - zcbor
          - littlefs
          - fatfs

    - name: lvgl
      remote: lvgl
      revision: 92708ebbbb88fed2db15dfe9324f0dc546222301
      path: modules/lib/gui/lvgl

    - name: trusted-firmware-m
      remote: infineon-github
      repo-path: ifx-zephyr-trusted-firmware-m
      revision: 01fe3f388f70bc580a0180da2363ab5e62e6941e
      path: modules/tee/tf-m/trusted-firmware-m

    - name: hal_infineon
      remote: infineon-github
      repo-path: ifx-zephyr-hal_infineon
      revision: 2a16709f98f47a7a823162c5731d6b4f63a7da72
      path: modules/hal/infineon

    # -----------------------------------------------------------------------
    # Infineon ML Middleware — MTB-style mtb_ml_* API + NNLite / Ethos-U55
    # backend glue.
    # -----------------------------------------------------------------------
    - name: mtb-ml-middleware
      remote: infineon-github
      repo-path: ml-middleware
      revision: release-v3.2.0
      path: modules/hal/infineon/ml-middleware/mtb-ml-middleware

    # -----------------------------------------------------------------------
    # Infineon ML TFLite Micro precompiled library.
    # Provides libtensorflow-microlite.a variants compiled per NPU target
    # (NNLite/NNLITE2, Ethos-U55).  Consumed by the ML Middleware CMakeLists.
    # -----------------------------------------------------------------------
    - name: mtb-ml-tflite-micro
      remote: infineon-github
      repo-path: ml-tflite-micro
      revision: release-v3.2.0
      path: modules/hal/infineon/ml-tflite-micro/mtb-ml-tflite-micro

    # -----------------------------------------------------------------------
    # emUSB device support for Infineon boards.
    # -----------------------------------------------------------------------
    - name: emusb-device
      remote: infineon-github
      repo-path: emusb-device
      revision: 75f865d1514e7bde3efac8131b31dc4e5de2a5bd # release-v2.2.1
      path: modules/hal/infineon/emusb-device
```
