## CMakeLists.txt
```
# SPDX-License-Identifier: Apache-2.0

cmake_minimum_required(VERSION 3.20.0)

# Register the Infineon ML modules explicitly so that Zephyr's CMake sources
# their module.yml / Kconfig files regardless of which branch zephyr/west.yml
# is on.  ZEPHYR_EXTRA_MODULES must be set before find_package(Zephyr).
#
# Note: The modules are already registered in the SDK's west.yml manifest
# at modules/lib/ml-middleware and modules/lib/ml-tflite-micro, so they
# should be automatically available via west's module discovery.

find_package(Zephyr REQUIRED HINTS $ENV{ZEPHYR_BASE})
project(kit_pse84_ai_ml_demo)

# Select the DEEPCRAFT model based on target core:
#   Cortex-M55 → models/ethosu55/  (Vela-compiled for Ethos-U55 NPU)
#   Cortex-M33 → models/nnlite/    (compiled for NNLite NPU)
#
# CONFIG_CPU_CORTEX_M55 / CONFIG_CPU_CORTEX_M33 are set by the board Kconfig
# and are available to CMake via the Zephyr Kconfig cache.
if(CONFIG_CPU_CORTEX_M55)
  set(MODEL_DIR ${CMAKE_CURRENT_SOURCE_DIR}/models/ethosu55)
  message(STATUS "ML model: ethosu55 (Cortex-M55 / Ethos-U55)")
elseif(CONFIG_CPU_CORTEX_M33)
  set(MODEL_DIR ${CMAKE_CURRENT_SOURCE_DIR}/models/nnlite)
  message(STATUS "ML model: nnlite (Cortex-M33 / NNLite NPU)")
else()
  message(FATAL_ERROR "No model directory defined for this core. "
    "Add a models/<core>/ directory and extend the selection above.")
endif()

# Application source — model.c implements IMAI_init/enqueue/dequeue via the
# Infineon ML Middleware (mtb_ml_model_init / mtb_ml_run_inference internally).
target_sources(app PRIVATE
  src/main.c
  ${MODEL_DIR}/model.c
)

# model.c is generated code (ImagiNet Compiler) and does not include <stdio.h>
# despite calling printf.  Force-include it for that file only so the
# generated source is never modified.
set_source_files_properties(${MODEL_DIR}/model.c PROPERTIES
  COMPILE_OPTIONS "-include;stdio.h"
)

# Include directories:
#   src/        — cy_retarget_io.h stub (printf already works via Zephyr console)
#   MODEL_DIR   — model.h with IMAI API declarations and constants
target_include_directories(app PRIVATE
  ${CMAKE_CURRENT_SOURCE_DIR}/src
  ${MODEL_DIR}
)

# model.c compile-time guards (checked via #error if missing):
#   COMPONENT_ML_TFLM   — provided by CONFIG_ML_MIDDLEWARE_TFLITE_INTERPRETER=y
#   COMPONENT_ML_INT8x8 — provided by CONFIG_ML_MIDDLEWARE_INT8=y
# Both are set as zephyr_compile_definitions by ml-middleware/zephyr/CMakeLists.txt
# and propagate to all targets including app. Listed here for documentation only.
```

## Kconfig
```
# Copyright (c) 2026 Infineon Technologies AG
# SPDX-License-Identifier: Apache-2.0

# Allow Vela-compiled model blobs (needed for Ethos-U NPU inference)
config TAINT_BLOBS_TFLM
	bool
	default y
	select TAINT_BLOBS

config TAINT_BLOBS_TFLM_ETHOSU
	bool "Use Vela-compiled model targeting Ethos-U NPU"
	default y
	select TAINT_BLOBS_TFLM
	help
	  Enable to use a Vela-optimized TFLite model that targets the
	  Arm Ethos-U55 NPU via the Infineon ML Middleware integration.
	  The DEEPCRAFT-generated model.c contains a Vela-compiled flatbuffer
	  that is dispatched to the NPU via the TFLite EthosuDelegate.

source "Kconfig.zephyr"
```

## sample.yaml
```
sample:
  name: PSE84 ML Middleware Demo
  description: >
    Demonstrates Infineon ML Middleware usage with NPU acceleration on PSE84.
    NNLite path targets kit_pse84_eval/pse846gps2dbzc4a/m33 (M33 + NNLite NPU).
    Ethos-U55 path targets kit_pse84_ai/pse846gps2dbzc4a/m55 (M55 + Ethos-U55 NPU).
tests:
  sample.boards.pse84.ml_middleware.nnlite:
    platform_allow: kit_pse84_eval/pse846gps2dbzc4a/m33
    tags:
      - ml
      - ai
      - npu
      - infineon
      - nnlite
      - pse84
    extra_configs:
      - CONFIG_ML_MIDDLEWARE_NNLITE=y
    harness: console
    harness_config:
      type: multi_line
      regex:
        - "ML Middleware Demo Started"
        - "Model loaded successfully"
        - "Inference completed"
  sample.boards.pse84.ml_middleware.u55:
    platform_allow: kit_pse84_ai/pse846gps2dbzc4a/m55
    tags:
      - ml
      - ai
      - npu
      - infineon
      - ethos_u55
      - pse84
    extra_configs:
      - CONFIG_ML_MIDDLEWARE_ETHOS_U55=y
    harness: console
    harness_config:
      type: multi_line
      regex:
        - "ML Middleware Demo Started"
        - "Model loaded successfully"
        - "Inference completed"
common:
  modules:
    - hal_infineon
  build_only: true
```

## prj.conf
```kconfig
# Configuration for MTB ML middleware with real TFLite Micro backend

# Enable logging
CONFIG_LOG=y
CONFIG_LOG_DEFAULT_LEVEL=3
CONFIG_CONSOLE=y
CONFIG_UART_CONSOLE=y

# Basic system requirements
CONFIG_HEAP_MEM_POOL_SIZE=16384
CONFIG_MAIN_STACK_SIZE=4096
CONFIG_SYSTEM_WORKQUEUE_STACK_SIZE=2048
CONFIG_GPIO=y

# C++ support for TFLite Micro
CONFIG_CPP=y
CONFIG_STD_CPP17=y
CONFIG_GLIBCXX_LIBCPP=y
```

## overlay-m55-imai.conf
```kconfig
# Overlay for M55 + Ethos-U55 + Infineon ML Middleware + DEEPCRAFT IMAI model
#
# Build command:
#   west build --pristine -b kit_pse84_ai/pse846gps2dbzc4a/m55 --sysbuild \
#     samples/boards/infineon/kit_pse84_ai/ml-example \
#     -- -DOVERLAY_CONFIG="overlay-m55-imai.conf"
#
# Architecture:
#   DEEPCRAFT model.c (IMAI_init/enqueue/dequeue)
#     -> Infineon ML Middleware (mtb_ml_model_init, mtb_ml_model_run)
#       -> TFLite Micro interpreter (Infineon precompiled libtensorflow-microlite.a)
#         -> Ethos-U delegate (Vela-compiled model ops dispatched to U55 NPU)
#
# Hardware init for Ethos-U55 is done at board level via CONFIG_ETHOS_U_INFINEON.
# The Infineon ML Middleware layer (COMPONENT_ML_TFLM) sits on top without
# duplicating hardware init — mtb_ml_init() is a lightweight counter when
# COMPONENT_U55 is not defined.

# --- Infineon ML Middleware ---
CONFIG_ML_MIDDLEWARE_INFINEON=y
CONFIG_ML_MIDDLEWARE_TFLITE_INTERPRETER=y
# INT8x8: required by DEEPCRAFT Radar model (int8 quantized, Vela-compiled)
CONFIG_ML_MIDDLEWARE_INT8=y

# --- C++ runtime (required by mtb_ml_model.cpp and TFLite) ---
CONFIG_CPP=y
CONFIG_STD_CPP17=y

# --- Ethos-U55 NPU via Infineon ML Middleware ---
# CONFIG_ML_MIDDLEWARE_ETHOS_U55: selects the Ethos-U55 path inside the ML
#   Middleware. The ML Middleware owns all NPU hardware init (ethosu_init etc.)
#   directly via mtb_ml_ethosu.c + ethos-u-core-driver compiled by the
#   ml-middleware CMakeLists.
#   The TFLite Micro CUSTOM op kernel (Register_ETHOSU / GetString_ETHOSU) is
#   also compiled by ml-middleware CMakeLists (ethosu_tflm_kernel.cc).
#   CONFIG_ETHOS_U is intentionally NOT set: it would auto-select
#   CONFIG_ETHOS_U_INFINEON (the native Zephyr vendor driver) which conflicts
#   with the ML Middleware's own NPU init.
CONFIG_ML_MIDDLEWARE_ETHOS_U55=y
# CONFIG_TAINT_BLOBS_TFLM_ETHOSU: allows linking Vela-compiled operator blobs
CONFIG_TAINT_BLOBS_TFLM_ETHOSU=y

# --- Memory ---
# model.h: buffers=32500, state=42924, readonly=93808 bytes
# Heap needed for mtb_ml_model_t + MTBTFLiteMicro C++ object (~4KB)
CONFIG_HEAP_MEM_POOL_SIZE=16384
CONFIG_MAIN_STACK_SIZE=8192
CONFIG_SYSTEM_WORKQUEUE_STACK_SIZE=2048

# --- Console/logging ---
CONFIG_LOG=y
CONFIG_LOG_MODE_IMMEDIATE=y
CONFIG_REQUIRES_FLOAT_PRINTF=y
```

## overlay-nnlite.conf
```kconfig
# Configuration overlay for M33 + NNLite NPU + Infineon ML Middleware + DEEPCRAFT IMAI model
#
# Build command (from ml-middleware-example/ directory):
#   west build --pristine -b kit_pse84_eval/pse846gps2dbzc4a/m33 \
#     . -- -DOVERLAY_CONFIG="overlay-nnlite.conf"
#
# TF-M is pre-provisioned on the PSE84 secure side; no --sysbuild needed.
# Zephyr runs in the M33 secure world (TRUSTED_EXECUTION_SECURE=y).

# --- Infineon ML Middleware ---
CONFIG_ML_MIDDLEWARE_INFINEON=y
CONFIG_ML_MIDDLEWARE_TFLITE_INTERPRETER=y
CONFIG_ML_MIDDLEWARE_INT8=y

# --- NNLite NPU via ML Middleware ---
CONFIG_ML_MIDDLEWARE_NNLITE=y

# Dynamic interrupt support required by the Cy_SysInt_Init Zephyr shim.
# cy_nn_kernel.c calls Cy_SysInt_Init() to register the NNLite/DMA ISRs at
# runtime.  The shim (modelled on cat1a/common/soc.c) uses irq_connect_dynamic,
# which requires CONFIG_DYNAMIC_INTERRUPTS=y.  Without it the shim compiles but
# does nothing and the NNLite interrupt never fires.
CONFIG_DYNAMIC_INTERRUPTS=y

# Note: CONFIG_TENSORFLOW_LITE_MICRO must NOT be set here.
# The Infineon ml-tflite-micro asset provides libtensorflow-microlite.a
# (precompiled, NPU-variant-specific). Enabling the Zephyr source-built
# tflite-micro module simultaneously causes duplicate symbol link errors.

# --- C++ runtime (required by mtb_ml_model.cpp and TFLite) ---
CONFIG_CPP=y
CONFIG_STD_CPP17=y

# --- Memory (M33 NS total RAM ~132KB; keep heap small) ---
CONFIG_MAIN_STACK_SIZE=8192
CONFIG_HEAP_MEM_POOL_SIZE=16384
CONFIG_SYSTEM_WORKQUEUE_STACK_SIZE=2048

# --- Console/logging ---
CONFIG_LOG=y
CONFIG_LOG_MODE_IMMEDIATE=y
CONFIG_REQUIRES_FLOAT_PRINTF=y
```

## src/main.c
```c
/*
 * Copyright (c) 2026 Infineon Technologies AG
 *
 * SPDX-License-Identifier: Apache-2.0
 */

/**
 * @file main.c
 * @brief DEEPCRAFT ML Model Integration via Infineon ML Middleware on Zephyr
 *
 * Demonstrates how a DEEPCRAFT Studio-generated model.c/.h integrates with
 * Zephyr RTOS using the Infineon ML Middleware as the integration layer.
 *
 * The DEEPCRAFT IMAI API encapsulates the full inference pipeline:
 *   IMAI_init()     — initialises ML middleware + TFLite interpreter + NPU
 *   IMAI_enqueue()  — feeds input data
 *   IMAI_dequeue()  — retrieves output
 *
 */

#include <zephyr/kernel.h>
#include <zephyr/logging/log.h>
#include <zephyr/sys/printk.h>
#include <string.h>

/* DEEPCRAFT-generated IMAI API — implemented in model.c.
 * model.h also exposes: IMAI_DATA_IN_COUNT (128), IMAI_DATA_OUT_COUNT (3),
 * IMAI_RET_SUCCESS, IMAI_RET_NODATA, IMAI_RET_ERROR */
#include "model.h"

/* Infineon ML Middleware API for lifecycle verification */
#include "mtb_ml.h"
/* Zephyr-specific ML Middleware helpers — defines mtb_ml_get_npu_type() */
#include "mtb_ml_zephyr.h"

LOG_MODULE_REGISTER(ml_imai_demo, LOG_LEVEL_INF);

/* Class labels come directly from model.h via IMAI_DATA_OUT_SYMBOLS.
 * This macro expands to a brace-enclosed string list, so we use it to
 * initialise the array — no hardcoded strings in main.c. */
static const char *const class_labels[] = IMAI_DATA_OUT_SYMBOLS;

/* Model GUID bytes from model.h — printed at startup for traceability. */
static const uint8_t model_id[] = IMAI_MODEL_ID;

int main(void)
{
	int ret;
	float input[IMAI_DATA_IN_COUNT];   /* dummy input frame     */
	float output[IMAI_DATA_OUT_COUNT]; /* class probabilities  */

	printk("\n=== DEEPCRAFT ML Middleware Demo ===\n");
	printk("NPU: %s\n", mtb_ml_get_npu_type());
	/* Model GUID from model.h — uniquely identifies which DEEPCRAFT model
	 * was compiled in; no hardcoded name needed. */
	printk("Model ID: %02x%02x%02x%02x-%02x%02x-%02x%02x-%02x%02x-%02x%02x%02x%02x%02x%02x\n",
	       model_id[0], model_id[1], model_id[2], model_id[3],
	       model_id[4], model_id[5], model_id[6], model_id[7],
	       model_id[8], model_id[9], model_id[10], model_id[11],
	       model_id[12], model_id[13], model_id[14], model_id[15]);
	printk("Input:   float[%d]\n", IMAI_DATA_IN_COUNT);
	printk("Output:  float[%d] classes:", IMAI_DATA_OUT_COUNT);
	for (int i = 0; i < IMAI_DATA_OUT_COUNT; i++) {
		printk(" %s", class_labels[i]);
	}
	printk("\n======================================\n\n");

	/* --- Step 1: Initialise the model via Infineon ML Middleware ---
	 * Internally calls:
	 *   mtb_ml_model_init()  — sets up TFLite interpreter with AllOpsResolver
	 *                          (includes EthosuDelegate for Vela-compiled ops)
	 *   mtb_ml_init()        — lightweight init; hardware already set up by
	 *                          Zephyr board driver (CONFIG_ETHOS_U_INFINEON) */
	LOG_INF("Initialising DEEPCRAFT model via Infineon ML Middleware...");
	ret = IMAI_init();
	if (ret != IMAI_RET_SUCCESS) {
		LOG_ERR("IMAI_init() failed: %d", ret);
		printk("FATAL: Model initialisation failed!\n");
		return -EIO;
	}
	LOG_INF("Model initialised successfully");

	/* --- Step 1b: Verify middleware init state via mtb_ml_get_init_state() ---
	 * mtb_ml_get_init_state() returns the internal reference count incremented
	 * by each call to mtb_ml_init(). IMAI_init() calls mtb_ml_init() once,
	 * so the count should be 1. */
	uint32_t init_state = mtb_ml_get_init_state();

	printk("mtb_ml_get_init_state() = %u (expected 1)\n", init_state);
	if (init_state != 1U) {
		LOG_WRN("Unexpected init state: %u", init_state);
	} else {
		LOG_INF("ML Middleware init state verified: %u", init_state);
	}

	/* --- Step 2: Run a simple inference loop ---
	 * Feed zero-valued input frames (simulated radar data) to demonstrate
	 * the pipeline.  Real usage would feed actual ADC/radar samples. */
	printk("Running inference loop (5 frames of zero-valued input)...\n");

	for (int frame = 0; frame < 5; frame++) {
		/* Synthesise a simple test pattern: zero frame */
		memset(input, 0, sizeof(input));

		/* Enqueue one input frame (float[128]).
		 * Returns IMAI_RET_SUCCESS (0) or IMAI_RET_NODATA (-1) if the
		 * fixed-window buffer is not yet full enough. */
		ret = IMAI_enqueue(input);
		if (ret == IMAI_RET_NODATA) {
			/* Normal — fixed window accumulating frames */
			LOG_DBG("Frame %d: window filling (%d)", frame, ret);
			continue;
		}
		if (ret != IMAI_RET_SUCCESS) {
			LOG_ERR("IMAI_enqueue() failed: %d", ret);
			break;
		}

		/* Dequeue output — runs inference on buffered window.
		 * Returns IMAI_RET_SUCCESS when output is ready. */
		ret = IMAI_dequeue(output);
		if (ret == IMAI_RET_NODATA) {
			LOG_DBG("Frame %d: no output yet", frame);
			continue;
		}
		if (ret != IMAI_RET_SUCCESS) {
			LOG_ERR("IMAI_dequeue() failed: %d", ret);
			break;
		}

		/* Print classification results */
		printk("Frame %d — Inference result:\n", frame);
		int best_idx = 0;
		for (int i = 0; i < IMAI_DATA_OUT_COUNT; i++) {
			printk("  [%d] %-12s: %.4f\n", i, class_labels[i],
			       (double)output[i]);
			if (output[i] > output[best_idx]) {
				best_idx = i;
			}
		}
		printk("  >> Detected: %s\n\n", class_labels[best_idx]);
	}

	/* --- Step 3: Cleanup ---
	 * IMAI_finalize() releases the TFLite interpreter via mtb_model_free(). */
	IMAI_finalize();
	LOG_INF("Model finalised");

	/* --- Step 4: Deinit the ML Middleware ---
	 * mtb_ml_deinit() decrements the internal reference count.
	 * After this call, mtb_ml_get_init_state() should return 0. */
	cy_rslt_t deinit_result = mtb_ml_deinit();

	if (deinit_result != CY_RSLT_SUCCESS) {
		LOG_WRN("mtb_ml_deinit() returned: 0x%08x", deinit_result);
	}
	init_state = mtb_ml_get_init_state();
	printk("mtb_ml_get_init_state() after deinit = %u (expected 0)\n", init_state);
	LOG_INF("ML Middleware deinit state: %u", init_state);

	printk("======================================================\n");
	printk("DEEPCRAFT ML Middleware demo complete.\n");

	return 0;
}
```

## src/cy_retarget_io.h
```c
/*
 * Stub for cy_retarget_io.h — not needed on Zephyr.
 * In ModusToolbox, cy_retarget_io routes printf to UART.
 * On Zephyr, printf is handled via picolibc -> Zephyr console.
 * DEEPCRAFT-generated model.c includes this header but does not
 * call any cy_retarget_io functions at runtime.
 */
#ifndef CY_RETARGET_IO_H
#define CY_RETARGET_IO_H

/* intentionally empty */

#endif /* CY_RETARGET_IO_H */
```
