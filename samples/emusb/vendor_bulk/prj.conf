## CMakeLists.txt
```
# SPDX-FileCopyrightText: Copyright (c) 2026 Infineon Technologies AG,
# SPDX-FileCopyrightText: or an affiliate of Infineon Technologies AG. All rights reserved.
#
# SPDX-License-Identifier: Apache-2.0

cmake_minimum_required(VERSION 3.20.0)

find_package(Zephyr REQUIRED HINTS $ENV{ZEPHYR_BASE})
project(emusb_vendor_bulk)

target_sources(app PRIVATE
  src/main.c
  src/vendor_bulk.c
  src/usbd_config.c
)
```

## Kconfig
```
# SPDX-FileCopyrightText: Copyright (c) 2026 Infineon Technologies AG,
# SPDX-FileCopyrightText: or an affiliate of Infineon Technologies AG. All rights reserved.
#
# SPDX-License-Identifier: Apache-2.0

mainmenu "emUSB vendor-class bulk sample"

choice APP_VENDOR_BULK_MODE
	prompt "Data path mode"
	default APP_VENDOR_BULK_MODE_SOURCE
	help
	  Selects what the device does with the bulk endpoints. Match this to
	  the host-side test direction (vendor_bulk_speed_test.py --mode):
	    source   -> host --mode in / in-async
	    sink     -> host --mode out

config APP_VENDOR_BULK_MODE_SOURCE
	bool "Source: stream a counter pattern on bulk IN"
	help
	  The device continuously generates a counter pattern and streams it on
	  the bulk IN endpoint (measures device-to-host throughput).

config APP_VENDOR_BULK_MODE_SINK
	bool "Sink: drain and discard bulk OUT"
	help
	  The device continuously reads the bulk OUT endpoint and discards the
	  data (measures host-to-device throughput). Nothing is sent on IN.

config APP_VENDOR_BULK_MODE_LOOPBACK
	bool "Loopback: echo bulk OUT back on bulk IN"
	help
	  The device reads the bulk OUT endpoint and echoes the data back on
	  bulk IN.

endchoice

config APP_VENDOR_BULK_XFER_SIZE
	int "Per-transfer size (bytes)"
	default 65536
	range 64 131072
	help
	  Size of each bulk IN/OUT transfer. Should be a multiple of 512 (HS)
	  for best throughput. Larger transfers reduce the number of
	  transfer-boundary bubbles on the wire (each overlapped transfer keeps
	  the DMA engine streaming longer), at the cost of more DMA-reachable
	  RAM for the source/echo buffer.

config APP_VENDOR_BULK_STATS
	bool "Print device-side throughput statistics once per second"
	default y
	depends on APP_VENDOR_BULK_MODE_SOURCE || APP_VENDOR_BULK_MODE_SINK
	help
	  When enabled, the device reports its measured transfer rate (MiB/s)
	  and transfers/second once per second. In source mode it also reports
	  how often the overlapped write queue fully drained: a non-zero drain
	  count means the endpoint went idle waiting for the worker to refill
	  (a closable gap); near zero means the device is streaming at the
	  driver/bus ceiling. Disable to rule out any observer effect on timing.

source "Kconfig.zephyr"
```

## sample.yaml
```
# SPDX-FileCopyrightText: Copyright (c) 2026 Infineon Technologies AG,
# SPDX-FileCopyrightText: or an affiliate of Infineon Technologies AG. All rights reserved.
#
# SPDX-License-Identifier: Apache-2.0

sample:
  name: PSE84 emUSB-Device Vendor Bulk
  description: >
    Vendor-class bulk throughput sample on the SEGGER emUSB-Device stack
    (Infineon pre-compiled library) for PSE84 USBHS. Producer mode streams a
    counter pattern on bulk IN; loopback mode echoes OUT to IN.
tests:
  sample.usb.emusb.vendor_bulk:
    platform_allow:
      - kit_pse84_eval/pse846gps2dbzc4a/m33/ns
      - kit_pse84_eval/pse846gps2dbzc4a/m55
    integration_platforms:
      - kit_pse84_eval/pse846gps2dbzc4a/m33/ns
      - kit_pse84_eval/pse846gps2dbzc4a/m55
    sysbuild: true
    tags:
      - usb
      - emusb
      - bulk
      - infineon
      - pse84
    harness: console
    harness_config:
      type: one_line
      regex:
        - "PSE84 emUSB-Device: vendor bulk sample"
    build_only: true
common:
  modules:
    - hal_infineon
    - emusb-device
```

## prj.conf
```kconfig
# SPDX-FileCopyrightText: Copyright (c) 2026 Infineon Technologies AG,
# SPDX-FileCopyrightText: or an affiliate of Infineon Technologies AG. All rights reserved.
#
# SPDX-License-Identifier: Apache-2.0
#
# emUSB vendor-class bulk sample.

# Use the SEGGER emUSB-Device stack with the RTOS-aware OS abstraction.
CONFIG_EMUSB_DEVICE=y
CONFIG_EMUSB_DEVICE_RTOS_AWARE=y

# Use the DMA USB driver for high bulk throughput (offloads the FIFO copy).
CONFIG_EMUSB_DEVICE_DMA=y

# emUSB owns the USBHS controller; keep Zephyr's own USB stack out.
CONFIG_USB_DEVICE_STACK=n
CONFIG_USB_DEVICE_STACK_NEXT=n
CONFIG_UDC_DRIVER=n

# Application needs.
CONFIG_FPU=y
CONFIG_MAIN_STACK_SIZE=4096

# The Infineon abstraction-rtos Zephyr backend (emUSB OS layer) uses the
# kernel event objects (k_event_*).
CONFIG_EVENTS=y

# Console output via printk.
CONFIG_SERIAL=y
CONFIG_CONSOLE=y
CONFIG_UART_CONSOLE=y
CONFIG_PRINTK=y

# Sample options (see Kconfig). Data path mode: source (IN) / sink (OUT) /
# loopback. Match to the host test direction (--mode in / out).
CONFIG_APP_VENDOR_BULK_MODE_SOURCE=y
CONFIG_APP_VENDOR_BULK_XFER_SIZE=65536
```

## boards/kit_pse84_eval_pse846gps2dbzc4a_m55.conf
```kconfig
# SPDX-FileCopyrightText: Copyright (c) 2026 Infineon Technologies AG,
# SPDX-FileCopyrightText: or an affiliate of Infineon Technologies AG. All rights reserved.
#
# SPDX-License-Identifier: Apache-2.0
#
# M55-specific overrides for the emUSB vendor bulk sample.
#
# The Cortex-M55 boots with the data cache enabled, so the USB DMA buffers
# (endpoint memory pool + the app's bulk buffers) are placed in a non-cacheable
# section to stay coherent with the USB DMA engine (see VB_DMA_MEM / __nocache
# in src/main.c and src/usbd_config.c).

CONFIG_NOCACHE_MEMORY=y
```

## src/main.c
```c
/*
 * SPDX-FileCopyrightText: Copyright (c) 2026 Infineon Technologies AG,
 * SPDX-FileCopyrightText: or an affiliate of Infineon Technologies AG. All rights reserved.
 *
 * SPDX-License-Identifier: Apache-2.0
 *
 * emUSB-Device vendor-class bulk sample (Zephyr, Infineon PSE84 USBHS).
 *
 * A dedicated worker thread drives the data path:
 *   - Producer mode: continuously stream a counter pattern on bulk IN using
 *     overlapped (non-blocking) writes, keeping the stack's transfer queue
 *     full so the endpoint is never starved between transfers (maximum
 *     throughput; see USBD_BULK_WaitForTXReady in the emUSB manual).
 *   - Loopback mode: blocking read on bulk OUT, echoed back on bulk IN.
 *
 * When CONFIG_APP_VENDOR_BULK_STATS is enabled the producer reports the
 * device-side transfer rate once per second (see the main loop).
 */

#include <string.h>

#include <zephyr/kernel.h>

#include "USB.h"

#include "vendor_bulk.h"
#include "vb_dma_mem.h"

/* Zephyr project test IDs (do NOT ship outside samples). */
#define VENDOR_ID  (0x2FE3)
#define PRODUCT_ID (0x000A)

#define XFER_SIZE CONFIG_APP_VENDOR_BULK_XFER_SIZE

/* Worker thread that runs the bulk data path once the device is configured. */
#define VB_THREAD_STACK_SIZE 2048
#define VB_THREAD_PRIO       5

#if defined(CONFIG_APP_VENDOR_BULK_MODE_SOURCE)
#define VB_MODE_NAME "source"
#elif defined(CONFIG_APP_VENDOR_BULK_MODE_SINK)
#define VB_MODE_NAME "sink"
#else
#define VB_MODE_NAME "loopback"
#endif

static const USB_DEVICE_INFO usb_dev_info = {
	VENDOR_ID,
	PRODUCT_ID,
	"Infineon Technologies",
	"emUSB vendor bulk sample",
	"0123456789",
};

#if defined(CONFIG_APP_VENDOR_BULK_STATS)
/* Throughput diagnostics (updated by the worker, sampled once/sec by main).
 * Counters are cumulative and read as per-second deltas; 32-bit wrap is
 * handled by unsigned subtraction of the delta. */
static atomic_t vb_bytes;  /* bytes transferred */
static atomic_t vb_xfers;  /* transfer count */
#if defined(CONFIG_APP_VENDOR_BULK_MODE_SOURCE)
static atomic_t vb_drains; /* times the TX queue had fully drained before refill */
#define VB_DIR_LABEL "IN"
#else
#define VB_DIR_LABEL "OUT"
#endif
#endif /* CONFIG_APP_VENDOR_BULK_STATS */

#if defined(CONFIG_APP_VENDOR_BULK_MODE_SOURCE)

/* Source buffer streamed on bulk IN. */
static uint8_t in_buf[XFER_SIZE] VB_DMA_MEM;

static void fill_pattern_once(void)
{
	for (size_t i = 0; i < XFER_SIZE; i += sizeof(uint32_t)) {
		uint32_t v = (uint32_t)(i / sizeof(uint32_t));

		in_buf[i + 0] = (uint8_t)(v);
		in_buf[i + 1] = (uint8_t)(v >> 8);
		in_buf[i + 2] = (uint8_t)(v >> 16);
		in_buf[i + 3] = (uint8_t)(v >> 24);
	}
}

static void vb_worker(void *a, void *b, void *c)
{
	ARG_UNUSED(a);
	ARG_UNUSED(b);
	ARG_UNUSED(c);

	fill_pattern_once();

	for (;;) {
		int r;

		if (!vendor_bulk_is_ready()) {
			k_msleep(10);
			continue;
		}

		/* Keep the stack's write queue full for maximum send speed:
		 * wait until it can accept another transfer, then submit an
		 * overlapped (non-blocking) write. Several transfers stay in
		 * flight, so the IN endpoint is not starved between them. */
		r = vendor_bulk_wait_tx_ready(100);
		if (r < 0) {
			/* Disconnected / reset while waiting. */
			k_msleep(10);
			continue;
		}
		if (r == 1) {
			/* Queue full within the timeout (host not draining). */
			continue;
		}

#if defined(CONFIG_APP_VENDOR_BULK_STATS)
		/* If nothing is pending at refill time, the endpoint went idle
		 * between transfers (a closable gap). Near-zero drains means we
		 * are streaming at the driver/bus ceiling. */
		if (vendor_bulk_bytes_pending() == 0) {
			atomic_inc(&vb_drains);
		}
#endif

		if (vendor_bulk_write_start(in_buf, XFER_SIZE) < 0) {
			k_msleep(10);
			continue;
		}

#if defined(CONFIG_APP_VENDOR_BULK_STATS)
		atomic_add(&vb_bytes, XFER_SIZE);
		atomic_inc(&vb_xfers);
#endif
	}
}

#elif defined(CONFIG_APP_VENDOR_BULK_MODE_SINK)

/* Discard buffer for draining bulk OUT (host-to-device throughput). */
static uint8_t sink_buf[XFER_SIZE] VB_DMA_MEM;

static void vb_worker(void *a, void *b, void *c)
{
	ARG_UNUSED(a);
	ARG_UNUSED(b);
	ARG_UNUSED(c);

	for (;;) {
		int n;

		if (!vendor_bulk_is_ready()) {
			k_msleep(10);
			continue;
		}

		/* Blocking read drains whatever the host writes on bulk OUT;
		 * the data is discarded. A large read receives many packets per
		 * call, keeping the endpoint armed for the whole transfer. */
		n = vendor_bulk_read(sink_buf, sizeof(sink_buf));
		if (n > 0) {
#if defined(CONFIG_APP_VENDOR_BULK_STATS)
			atomic_add(&vb_bytes, n);
			atomic_inc(&vb_xfers);
#endif
		} else if (n < 0) {
			k_msleep(10);
		}
	}
}

#else /* CONFIG_APP_VENDOR_BULK_MODE_LOOPBACK */

static uint8_t io_buf[XFER_SIZE] VB_DMA_MEM;

static void vb_worker(void *a, void *b, void *c)
{
	ARG_UNUSED(a);
	ARG_UNUSED(b);
	ARG_UNUSED(c);

	for (;;) {
		int n;

		if (!vendor_bulk_is_ready()) {
			k_msleep(10);
			continue;
		}

		n = vendor_bulk_read(io_buf, sizeof(io_buf));
		if (n > 0) {
			(void)vendor_bulk_write(io_buf, (size_t)n);
		} else if (n < 0) {
			k_msleep(10);
		}
	}
}

#endif /* mode */

K_THREAD_DEFINE(vb_worker_tid, VB_THREAD_STACK_SIZE, vb_worker, NULL, NULL, NULL,
		VB_THREAD_PRIO, 0, 0);

int main(void)
{
	bool ready = false;
#if defined(CONFIG_APP_VENDOR_BULK_STATS)
	int64_t stats_last = k_uptime_get();
	atomic_val_t bytes_last = 0;
	atomic_val_t xfers_last = 0;
#if defined(CONFIG_APP_VENDOR_BULK_MODE_SOURCE)
	atomic_val_t drains_last = 0;
#endif
#endif

	printk("\nPSE84 emUSB-Device: vendor bulk sample (" VB_MODE_NAME " mode)\n");

	USBD_Init();
	vendor_bulk_add();

	USBD_SetDeviceInfo(&usb_dev_info);
	USBD_Start();

	/* Track configured state; the worker thread runs the data path while
	 * enabled. */
	for (;;) {
		bool configured =
			(USBD_GetState() &
			 (USB_STAT_CONFIGURED | USB_STAT_SUSPENDED)) == USB_STAT_CONFIGURED;

		if (configured != ready) {
			ready = configured;
			vendor_bulk_set_enabled(ready);
			printk("vendor bulk %s\n", ready ? "ready" : "not ready");
		}

		k_msleep(100);

#if defined(CONFIG_APP_VENDOR_BULK_STATS)
		if (ready) {
			int64_t now = k_uptime_get();
			int64_t dt = now - stats_last;

			if (dt >= 1000) {
				atomic_val_t b = atomic_get(&vb_bytes);
				atomic_val_t x = atomic_get(&vb_xfers);
				uint32_t dbytes =
					(uint32_t)b - (uint32_t)bytes_last;
				uint32_t mib_x100 =
					(uint32_t)(((uint64_t)dbytes * 100U * 1000U) /
						   ((uint64_t)dt * 1024U * 1024U));

#if defined(CONFIG_APP_VENDOR_BULK_MODE_SOURCE)
				atomic_val_t d = atomic_get(&vb_drains);

				printk(VB_DIR_LABEL ": %u.%02u MiB/s  %u xfers/s  %u drains/s\n",
				       mib_x100 / 100U, mib_x100 % 100U,
				       (unsigned)(x - xfers_last),
				       (unsigned)(d - drains_last));
				drains_last = d;
#else
				printk(VB_DIR_LABEL ": %u.%02u MiB/s  %u xfers/s\n",
				       mib_x100 / 100U, mib_x100 % 100U,
				       (unsigned)(x - xfers_last));
#endif
				bytes_last = b;
				xfers_last = x;
				stats_last = now;
			}
		}
#endif
	}

	return 0;
}
```

## src/usbd_config.c
```c
/*
 * SPDX-FileCopyrightText: Copyright (c) 2026 Infineon Technologies AG,
 * SPDX-FileCopyrightText: or an affiliate of Infineon Technologies AG. All rights reserved.
 *
 * SPDX-License-Identifier: Apache-2.0
 *
 * Application platform configuration for the pre-compiled emUSB-Device library
 * on Zephyr / Infineon PSE84.
 *
 * Provides the emUSB USBD_X_Config() hook: bring up the USBHS PHY, select the
 * PSE84 hardware driver (the DMA variant when CONFIG_EMUSB_DEVICE_DMA is set,
 * otherwise the slave/FIFO variant), assign the endpoint memory pool, and
 * register the ISR-enable callback. Also supplies the emUSB log/panic hooks.
 * The USBHS clock/PHY bring-up and IRQ wiring live in the SDK emUSB
 * integration (ifx_emusb_usbhs.h).
 */

#include <zephyr/kernel.h>

#include "USB.h"
#include "USB_HW_Infineon_PSOCE84.h"
#include "ifx_emusb_usbhs.h"

#include "vb_dma_mem.h"

/* Memory pool the stack uses for endpoint buffers and transfer descriptors.
 * It is a DMA target for the USB controller, so it lives in VB_DMA_MEM
 * (non-cacheable on M55). */
#define EP_BUFFER_SIZE (4096u)
static uint32_t memory_pool[EP_BUFFER_SIZE / 4u] VB_DMA_MEM;

void USBD_X_Config(void)
{
	ifx_emusb_usbhs_phy_enable();

#if defined(CONFIG_EMUSB_DEVICE_DMA)
	USBD_AddDriver(&USB_Driver_Infineon_PSOCE84_DMA);
	ifx_emusb_dma_configure();
#else
	USBD_AddDriver(&USB_Driver_Infineon_PSOCE84);
#endif
	USBD_AssignMemory(memory_pool, sizeof(memory_pool));
	USBD_SetISREnableFunc(ifx_emusb_enable_isr);
}

void USB_OS_Panic(const char *pErrMsg)
{
	printk("emUSB PANIC: %s\n", (pErrMsg != NULL) ? pErrMsg : "");
	k_panic();

	for (;;) {
		/* unreachable */
	}
}

void USB_X_Log(const char *s)
{
	ARG_UNUSED(s);
}

void USB_X_Warn(const char *s)
{
	printk("emUSB: %s\n", (s != NULL) ? s : "");
}
```

## src/vb_dma_mem.h
```c
/*
 * SPDX-FileCopyrightText: Copyright (c) 2026 Infineon Technologies AG,
 * SPDX-FileCopyrightText: or an affiliate of Infineon Technologies AG. All rights reserved.
 *
 * SPDX-License-Identifier: Apache-2.0
 */

#ifndef SAMPLES_EMUSB_VENDOR_BULK_VB_DMA_MEM_H_
#define SAMPLES_EMUSB_VENDOR_BULK_VB_DMA_MEM_H_

#include <zephyr/kernel.h>

/*
 * Attribute for buffers the USB controller DMAs to/from. On M55 (D-cache
 * enabled) they must be non-cacheable to stay coherent with the DMA engine; on
 * M33 (no data cache) nocache is unavailable, so only the cache-line alignment
 * applies.
 */
#if defined(CONFIG_NOCACHE_MEMORY)
#define VB_DMA_MEM __nocache __aligned(32)
#else
#define VB_DMA_MEM __aligned(32)
#endif

#endif /* SAMPLES_EMUSB_VENDOR_BULK_VB_DMA_MEM_H_ */
```

## src/vendor_bulk.c
```c
/*
 * SPDX-FileCopyrightText: Copyright (c) 2026 Infineon Technologies AG,
 * SPDX-FileCopyrightText: or an affiliate of Infineon Technologies AG. All rights reserved.
 *
 * SPDX-License-Identifier: Apache-2.0
 *
 * Vendor-class bulk USB function on emUSB-Device (Infineon PSE84).
 *
 * The data path runs from a dedicated worker thread (see main.c):
 *   - The producer uses overlapped (non-blocking) writes gated by
 *     USBD_BULK_WaitForTXReady. So, the IN endpoint streams without gaps.
 *   - Loopback uses blocking USBD_BULK_Read + USBD_BULK_Write.
 * Both avoid a completion-callback resubmit pattern (which recurses on this
 * stack); emUSB handles buffering/backpressure internally.
 */

#include <errno.h>
#include <string.h>

#include <zephyr/kernel.h>
#include <zephyr/sys/atomic.h>

#include "USB.h"
#include "USB_Bulk.h"

#include "vendor_bulk.h"
#include "vb_dma_mem.h"

/* High-speed bulk max packet size (512). emUSB negotiates FS/HS internally. */
#define VB_BULK_MPS USB_HS_BULK_MAX_PACKET_SIZE

/* Receive (staging) buffer for the bulk OUT endpoint. emUSB requires an OUT
 * endpoint buffer of at least MaxPacketSize (unlike IN, which can be NULL for
 * the zero-copy DMA path). The controller DMAs incoming packets here, so it
 * lives in VB_DMA_MEM; a few packets deep to absorb bursts between reads. */
#define VB_EP_OUT_BUF_SIZE (8u * VB_BULK_MPS)

static uint8_t vb_ep_out_buf[VB_EP_OUT_BUF_SIZE] VB_DMA_MEM;

static USB_BULK_HANDLE vb_handle;
static atomic_t vb_enabled;

void vendor_bulk_add(void)
{
	USB_ADD_EP_INFO ep_in;
	USB_ADD_EP_INFO ep_out;
	USB_BULK_INIT_DATA init;

	memset(&ep_in, 0, sizeof(ep_in));
	ep_in.Flags = 0;
	ep_in.InDir = USB_DIR_IN;
	ep_in.Interval = 0; /* ignored for bulk */
	ep_in.MaxPacketSize = VB_BULK_MPS;
	ep_in.TransferType = USB_TRANSFER_TYPE_BULK;

	memset(&ep_out, 0, sizeof(ep_out));
	ep_out.Flags = 0;
	ep_out.InDir = USB_DIR_OUT;
	ep_out.Interval = 0;
	ep_out.MaxPacketSize = VB_BULK_MPS;
	ep_out.TransferType = USB_TRANSFER_TYPE_BULK;

	memset(&init, 0, sizeof(init));
	/* IN: NULL/0 keeps the zero-copy DMA path (DMA straight from the
	 * caller's buffer). OUT: emUSB requires a receive buffer >= MaxPacketSize
	 * to land incoming packets; NULL here silently drops all OUT data. */
	init.EPIn = USBD_AddEPEx(&ep_in, NULL, 0);
	init.EPOut = USBD_AddEPEx(&ep_out, vb_ep_out_buf, sizeof(vb_ep_out_buf));

	vb_handle = USBD_BULK_Add(&init);

	/* Default interface class is vendor-specific (0xFF), matching the
	 * upstream sample. Use USBD_BULK_Add_Ex + USB_BULK_INIT_DATA_EX for a
	 * named interface or custom class IDs. */
}

void vendor_bulk_set_enabled(bool enabled)
{
	atomic_set(&vb_enabled, enabled ? 1 : 0);
}

bool vendor_bulk_is_ready(void)
{
	return atomic_get(&vb_enabled) != 0;
}

int vendor_bulk_write(const uint8_t *data, size_t len)
{
	if (!atomic_get(&vb_enabled)) {
		return -ENETDOWN;
	}

	/* Timeout 0 = block until the host has read the data. */
	return USBD_BULK_Write(vb_handle, data, (unsigned)len, 0);
}

int vendor_bulk_write_start(const uint8_t *data, size_t len)
{
	if (!atomic_get(&vb_enabled)) {
		return -ENETDOWN;
	}

	/* Timeout -1 = overlapped: queue the transfer and return immediately so
	 * the next one can be submitted while this one is still in flight. The
	 * stack queues a small number of transfers, keeping the endpoint fed
	 * across transfer boundaries. @p data must stay valid and unchanged
	 * until the transfer completes (the producer streams a persistent,
	 * never-modified buffer, so reusing it for several in-flight transfers
	 * is safe). Returns 0 when the transfer was started. */
	return USBD_BULK_Write(vb_handle, data, (unsigned)len, -1);
}

int vendor_bulk_wait_tx_ready(int timeout_ms)
{
	if (!atomic_get(&vb_enabled)) {
		return -ENETDOWN;
	}

	/* 0 = queue can accept another write, 1 = queue full (timeout), <0 err. */
	return USBD_BULK_WaitForTXReady(vb_handle, timeout_ms);
}

unsigned vendor_bulk_bytes_pending(void)
{
	return USBD_BULK_GetNumBytesRemToWrite(vb_handle);
}

int vendor_bulk_read(uint8_t *data, size_t len)
{
	if (!atomic_get(&vb_enabled)) {
		return -ENETDOWN;
	}

	/* Timeout 0 = block until at least one packet is received. */
	return USBD_BULK_Read(vb_handle, data, (unsigned)len, 0);
}
```

## src/vendor_bulk.h
```c
/*
 * SPDX-FileCopyrightText: Copyright (c) 2026 Infineon Technologies AG,
 * SPDX-FileCopyrightText: or an affiliate of Infineon Technologies AG. All rights reserved.
 *
 * SPDX-License-Identifier: Apache-2.0
 */

#ifndef SAMPLES_EMUSB_VENDOR_BULK_H_
#define SAMPLES_EMUSB_VENDOR_BULK_H_

#include <stddef.h>
#include <stdint.h>
#include <stdbool.h>

#ifdef __cplusplus
extern "C" {
#endif

/**
 * Register the vendor-class bulk interface with emUSB.
 *
 * Allocates the bulk IN and bulk OUT endpoints (USBD_AddEPEx) and adds the
 * emUSB Bulk class (USBD_BULK_Add, vendor class 0xFF). Must be called after
 * USBD_Init() and before USBD_Start().
 */
void vendor_bulk_add(void);

/**
 * Enable/disable the data path. Set true once the host has configured the
 * device (USB_STAT_CONFIGURED), false on disconnect/suspend.
 */
void vendor_bulk_set_enabled(bool enabled);

/** True after the host has configured the device and the class is enabled. */
bool vendor_bulk_is_ready(void);

/**
 * Blocking bulk write on the vendor-class IN endpoint.
 *
 * Must be called from a thread (never from a USB completion callback). Blocks
 * until the host has read all of @p data. @p data must stay valid until the
 * call returns. Used by loopback mode; the producer uses the overlapped
 * variant below.
 *
 * @return number of bytes written (>=0), or a negative emUSB error code.
 */
int vendor_bulk_write(const uint8_t *data, size_t len);

/**
 * Start an overlapped (non-blocking) bulk write on the IN endpoint.
 *
 * Queues the transfer and returns immediately; the data is sent
 * asynchronously. Gate submissions with vendor_bulk_wait_tx_ready() so the
 * stack's transfer queue is kept full — this keeps the IN endpoint fed across
 * transfer boundaries for maximum throughput. @p data must remain valid and
 * unchanged until the transfer completes.
 *
 * @return 0 if the transfer was started, negative on error/queue-full.
 */
int vendor_bulk_write_start(const uint8_t *data, size_t len);

/**
 * Wait until the IN transfer queue can accept another overlapped write.
 *
 * @param timeout_ms 0 = block forever (never reports full), >0 = bounded wait,
 *                   <0 = poll and return immediately.
 * @return 0 = a new write will be accepted, 1 = queue full (timeout),
 *         negative on error.
 */
int vendor_bulk_wait_tx_ready(int timeout_ms);

/**
 * Number of bytes still queued/pending on the IN endpoint (across all
 * in-flight overlapped writes). Returns 0 when the write pipeline has fully
 * drained. Used for throughput diagnostics. Does not block.
 */
unsigned vendor_bulk_bytes_pending(void);

/**
 * Blocking bulk read on the vendor-class OUT endpoint.
 *
 * @return number of bytes received (>=0), or a negative emUSB error code.
 */
int vendor_bulk_read(uint8_t *data, size_t len);

#ifdef __cplusplus
}
#endif

#endif /* SAMPLES_EMUSB_VENDOR_BULK_H_ */
```
